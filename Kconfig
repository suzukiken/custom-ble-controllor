## Kconfig
```kconfig
# SPDX-License-Identifier: MIT
# Loaded via zephyr/module.yml (ZMK_EXTRA_MODULES = this repo).

config ZMK_SOAK_STATUS
	bool "HID soak status on status-key press"
	depends on ZMK_BATTERY_REPORTING
	help
	  When the status matrix position is pressed (RP2040 virtual finger),
	  type: time: <uptime_s>, power=<percent>, mode=<label> + Enter

if ZMK_SOAK_STATUS

config ZMK_SOAK_STATUS_POSITION
	int "Matrix position that triggers status typing"
	default 0
	range 0 15
	help
	  Position index in the keymap (0 = D0 status key).

config ZMK_SOAK_STATUS_MODE
	string "Mode label in status line (mode=<label>)"
	default "sleep" if ZMK_SLEEP
	default "awake"

endif

config ZMK_POWER_DRAIN
	bool "Maximize power draw for battery drain tests"
	depends on ZMK_BATTERY_REPORTING
	help
	  Keep CPU busy, drive onboard RGB LEDs, spam HID, and periodically
	  type time/power so you can stop around ~50% SoC.

if ZMK_POWER_DRAIN

config ZMK_POWER_DRAIN_HID_MS
	int "HID spam interval (ms)"
	default 40
	range 10 1000

config ZMK_POWER_DRAIN_STATUS_MS
	int "Status line interval (ms)"
	default 30000
	range 5000 600000

endif
```

## boards/shields/awake_xiao_1min/Kconfig.defconfig
```kconfig
if SHIELD_AWAKE_XIAO_1MIN

config ZMK_KEYBOARD_NAME
	default "Awake 1min"

endif
```

## boards/shields/awake_xiao_1min/Kconfig.shield
```kconfig
config SHIELD_AWAKE_XIAO_1MIN
	def_bool $(shields_list_contains,awake_xiao_1min)
```

## boards/shields/awake_xiao_5min/Kconfig.defconfig
```kconfig
if SHIELD_AWAKE_XIAO_5MIN

config ZMK_KEYBOARD_NAME
	default "Awake 5min"

endif
```

## boards/shields/awake_xiao_5min/Kconfig.shield
```kconfig
config SHIELD_AWAKE_XIAO_5MIN
	def_bool $(shields_list_contains,awake_xiao_5min)
```

## boards/shields/awake_xiao_pi/Kconfig.defconfig
```kconfig
if SHIELD_AWAKE_XIAO_PI

config ZMK_KEYBOARD_NAME
	default "Awake Pi Xiao"

endif
```

## boards/shields/batt_1hz_xiao/Kconfig.defconfig
```kconfig
if SHIELD_BATT_1HZ_XIAO

config ZMK_KEYBOARD_NAME
	default "Batt1Hz Xiao"

endif
```

## boards/shields/batt_test_xiao/Kconfig.defconfig
```kconfig
if SHIELD_BATT_TEST_XIAO

config ZMK_KEYBOARD_NAME
	default "BattTest Xiao"

endif
```

## boards/shields/key_encoder_xiao/Kconfig.defconfig
```kconfig
if SHIELD_KEY_ENCODER_XIAO

config ZMK_KEYBOARD_NAME
	default "KeyEnc Xiao"

endif
```

## boards/shields/key_encoder_xiao/Kconfig.shield
```kconfig
config SHIELD_KEY_ENCODER_XIAO
	def_bool $(shields_list_contains,key_encoder_xiao)
```

## boards/shields/onekey_xiao/Kconfig.defconfig
```kconfig
if SHIELD_ONEKEY_XIAO

config ZMK_KEYBOARD_NAME
    default "OneKey Xiao"

endif
```

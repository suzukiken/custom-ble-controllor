## boards/shields/powerbtn_xiao/Kconfig.defconfig
```kconfig
if SHIELD_POWERBTN_XIAO

config ZMK_KEYBOARD_NAME
    default "PowerBtn Xiao"

endif
```

## boards/shields/push_encoder_xiao/Kconfig.defconfig
```kconfig
if SHIELD_PUSH_ENCODER_XIAO

config ZMK_KEYBOARD_NAME
	default "PushEncoder Xiao"

endif
```

## boards/shields/push_encoder_xiao/Kconfig.shield
```kconfig
config SHIELD_PUSH_ENCODER_XIAO
	def_bool $(shields_list_contains,push_encoder_xiao)
```

## boards/shields/sleep_xiao_1min/Kconfig.defconfig
```kconfig
if SHIELD_SLEEP_XIAO_1MIN

config ZMK_KEYBOARD_NAME
	default "Sleep 1min"

endif
```

## boards/shields/sleep_xiao_1min/Kconfig.shield
```kconfig
config SHIELD_SLEEP_XIAO_1MIN
	def_bool $(shields_list_contains,sleep_xiao_1min)
```

## boards/shields/sleep_xiao_2min/Kconfig.defconfig
```kconfig
if SHIELD_SLEEP_XIAO_2MIN

config ZMK_KEYBOARD_NAME
	default "Sleep 2min"

endif
```

## boards/shields/sleep_xiao_2min/Kconfig.shield
```kconfig
config SHIELD_SLEEP_XIAO_2MIN
	def_bool $(shields_list_contains,sleep_xiao_2min)
```

## boards/shields/sleep_xiao_5min/Kconfig.defconfig
```kconfig
if SHIELD_SLEEP_XIAO_5MIN

config ZMK_KEYBOARD_NAME
	default "Sleep 5min"

endif
```

## boards/shields/sleep_xiao_5min/Kconfig.shield
```kconfig
config SHIELD_SLEEP_XIAO_5MIN
	def_bool $(shields_list_contains,sleep_xiao_5min)
```

## boards/shields/sleep_xiao_pi/Kconfig.defconfig
```kconfig
if SHIELD_SLEEP_XIAO_PI

config ZMK_KEYBOARD_NAME
	default "Sleep Pi Xiao"

endif
```

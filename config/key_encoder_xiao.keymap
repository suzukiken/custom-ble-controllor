#include <behaviors.dtsi>
#include <dt-bindings/zmk/keys.h>

/ {
    keymap {
        compatible = "zmk,keymap";

        default_layer {
            bindings = <
                &kp SPACE
            >;
            sensor-bindings = <&inc_dec_kp UP DOWN>;
        };
    };
};

#include <behaviors.dtsi>
#include <dt-bindings/zmk/keys.h>

/ {
    keymap {
        compatible = "zmk,keymap";

        default_layer {
            /* D0=status trigger (no HID key; soak_status types the line) */
            bindings = <
                &none
            >;
        };
    };
};

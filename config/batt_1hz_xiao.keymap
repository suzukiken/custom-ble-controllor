#include <behaviors.dtsi>
#include <dt-bindings/zmk/keys.h>

/ {
    keymap {
        compatible = "zmk,keymap";

        default_layer {
            /* D0=RIGHT, D1=LEFT, D2=ENTER — RP2040 load; status via soak_status */
            bindings = <
                &kp RIGHT &kp LEFT &kp ENTER
            >;
        };
    };
};

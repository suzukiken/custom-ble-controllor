#include <behaviors.dtsi>
#include <dt-bindings/zmk/keys.h>

/ {
    keymap {
        compatible = "zmk,keymap";

        default_layer {
            /* D0=RIGHT (load), D1=status trigger (no HID; soak_status types line) */
            bindings = <
                &kp RIGHT
                &none
            >;
        };
    };
};
